## conf/machine/mxa200-imx8mp.conf
```bitbake
#machine configuration file for MXA200-IMX8MP

require conf/machine/include/imx8mp-evk.inc

#
# kernel
#
IMX_KERNEL_CONFIG_AARCH64:mxa200-imx8mp = "adlink_mxa200_defconfig"

# The device tree name is implicit for LPDDR4, so can't use MACHINE here
KERNEL_DEVICETREE_BASENAME = "mxa-200"
KERNEL_DEVICETREE = " \
	adlink/${KERNEL_DEVICETREE_BASENAME}.dtb \
	adlink/${KERNEL_DEVICETREE_BASENAME}_otg.dtb \
"

# over device tree overlay
EXTRA_OEMAKE:append:pn-linux-imx = " DTC_FLAGS='-@ -H epapr'"

# kernel patches
EXTRA_KERNEL_PATCHES = " \
	file://0001-MXA200-Commit-all-Craig-kernel-BBU-for-imx8mp-and-re.patch \
	file://adlink_mxa200_defconfig \
"
EXTRA_KERNEL_DTS = ""

KERNEL_SRC_PATCHES[mxa200-imx8mp] = " \
	${EXTRA_KERNEL_PATCHES} \
	${EXTRA_KERNEL_DTS} \
"

#
# u-boot
#
UBOOT_CONFIG_BASENAME = "adlink_mxa200"
UBOOT_CONFIG[fspi] = "${UBOOT_CONFIG_BASENAME}_defconfig"
UBOOT_DTB_NAME = "mxa-200.dtb"

# u-boot patches
EXTRA_UBOOT_PATCHES = " \
    file://0001-MXA200-Commit-all-Craig-uboot-BBU-for-imx8mp.patch \
    file://adlink_mxa200_defconfig \
    file://adlink_mxa200_inline_ecc_defconfig \
"
EXTRA_UBOOT_DTS = " \
"
UBOOT_SRC_PATCHES[mxa200-imx8mp] = " \
	${EXTRA_UBOOT_PATCHES} \
	${EXTRA_UBOOT_DTS} \
"

#
# DDR FIRMWARE
#
DDR_FIRMWARE_VERSION = "202006"
DDR_FIRMWARE_NAME = " \
        lpddr4_pmu_train_1d_dmem_${DDR_FIRMWARE_VERSION}.bin \
        lpddr4_pmu_train_1d_imem_${DDR_FIRMWARE_VERSION}.bin \
        lpddr4_pmu_train_2d_dmem_${DDR_FIRMWARE_VERSION}.bin \
        lpddr4_pmu_train_2d_imem_${DDR_FIRMWARE_VERSION}.bin \
"

#
# imx-mkimage (boot target)
#
IMXBOOT_TARGETS_BASENAME = "flash_evk"

# Serial debug console
SERIAL_CONSOLES = "115200;ttymxc2"

#
# imx-boot
#
IMAGE_BOOTLOADER = "imx-boot"
UBOOT_MAKE_TARGET = ""

# imx-atf (no change from default 0x30890000)
#ATF_BOOT_UART_BASE = "0x30890000"

#
# Image Format (wic)
#
WIC_PARTITION_TABLE_TYPE = "msdos"
WIC_FSTAB_BLKDEV = "mmcblk2"
IMAGE_FSTYPES:append = " wic wic.md5sum"
WKS_FILE_DEPENDS:append = " imx-m7-demos"
IMAGE_BOOT_FILES += "imx8mp_m7_TCM_hello_world.bin \
                    imx8mp_m7_TCM_rpmsg_lite_pingpong_rtos_linux_remote.bin \
                    imx8mp_m7_TCM_rpmsg_lite_str_echo_rtos.bin \
                    imx8mp_m7_TCM_sai_low_power_audio.bin \
"
```

## conf/machine/mxa200-imx8mpdesktop.conf
```bitbake
MACHINE="mxa200-imx8mp"
require conf/machine/mxa200-imx8mp.conf

include conf/machine/include/ubuntubasics.inc
```
