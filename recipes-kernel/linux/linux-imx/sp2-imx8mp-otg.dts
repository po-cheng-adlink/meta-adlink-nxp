// SPDX-License-Identifier: (GPL-2.0+ OR MIT)
/*
 * Copyright 2019 NXP
 */

/dts-v1/;

#include "mxa-200.dts"

/ {

    /delete-node/ gpio_switch;

		
		

	gpio_switch:gpio_switch{
			compatible = "mxa,gpio-switch";
			usb-mux-gpios = <&gpio1 1 GPIO_ACTIVE_LOW>;
			hub-reset-gpios = <&gpio1 12 GPIO_ACTIVE_HIGH>;
			hwid1-gpios = <&gpio5 5 GPIO_ACTIVE_LOW>;
			hwid2-gpios = <&gpio4 31 GPIO_ACTIVE_LOW>;
			hwid3-gpios = <&gpio5 0 GPIO_ACTIVE_LOW>;
			com1-mode0-gpios = <&gpio5 3 GPIO_ACTIVE_HIGH>;
			com1-mode1-gpios = <&gpio5 4 GPIO_ACTIVE_LOW>;
			com2-mode0-gpios = <&gpio3 23 GPIO_ACTIVE_HIGH>;
			com2-mode1-gpios = <&gpio3 24 GPIO_ACTIVE_LOW>;
			status = "okay";
	};
};

&usb_dwc3_0 {
	pinctrl-0 = <&pinctrl_usb0_id>,<&pinctrl_usb0_mux>;
	mux_gpios = <&gpio1 1 GPIO_ACTIVE_LOW>;
	dr_mode = "otg";
	status = "okay";
};





























